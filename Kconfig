## Kconfig
```kconfig
menu "COM LOG Configuration"
    config COM_LOG_DEFINITION
        bool "Enable COM LOG Definition"
        default n
        help
            Enable COM LOG Definition
endmenu
```
